#ifndef __OLED_H_
#define __OLED_H_
#include <STC15F2K60S2.H>
#include <delay.h>
/***************************************************************************************************************************************************
	0.96寸LCD12864函数*/
#define OLED_MODE 0
#define SIZE 8
#define XLevelL		0x00
#define XLevelH		0x10
#define Max_Column	128
#define Max_Row		64
#define	Brightness	0xFF
#define X_WIDTH 	128
#define Y_WIDTH 	64
#define high 1
#define low 0
#define OLED_CMD  0	//写命令
#define OLED_DATA 1	//写数据
sbit SCL=P2^0;
sbit SDA=P2^1;
//常用ASCII表
//偏移量32
//ASCII字符集
//偏移量32
//大小:12*6
/************************************6*8的点阵************************************/
u8 code F6x8[][6] =
{
	0x00, 0x00, 0x00, 0x00, 0x00, 0x00,// sp
	0x00, 0x00, 0x00, 0x2f, 0x00, 0x00,// !
	0x00, 0x00, 0x07, 0x00, 0x07, 0x00,// "
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	0x14, 0x14, 0x14, 0x14, 0x14, 0x14,// horiz lines
};
//8*16 ASCII字符集点阵
u8 code F8X16[]=
{
	0x00,0x00,0x00,0x00,0x00,0x00,0x00,0x00,0x00,0x00,0x00,0x00,0x00,0x00,0x00,0x00,// 0
	0x00,0x00,0x00,0xF8,0x00,0x00,0x00,0x00,0x00,0x00,0x00,0x33,0x30,0x00,0x00,0x00,//! 1
	0x00,0x10,0x0C,0x06,0x10,0x0C,0x06,0x00,0x00,0x00,0x00,0x00,0x00,0x00,0x00,0x00,//" 2
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	0x00,0x06,0x01,0x01,0x02,0x02,0x04,0x04,0x00,0x00,0x00,0x00,0x00,0x00,0x00,0x00,//~ 94
};
/**********************************************
//IIC Start
**********************************************/
void IIC_Start()
{
	SCL = high;
	SDA = high;
	SDA = low;
	SCL = low;
}
/**********************************************
//IIC Stop
**********************************************/
void IIC_Stop()
{
	SCL = low;
	SDA = low;
	SCL = high;
	SDA = high;
}
/**********************************************
// IIC Write byte
**********************************************/
void Write_IIC_Byte(u8 IIC_Byte)
{
	u8 i;
	for(i=0; i<8; i++)
	{
		if(IIC_Byte & 0x80)
			SDA=high;
		else
			SDA=low;
		SCL=high;
		SCL=low;
		IIC_Byte<<=1;
	}
	SDA=1;
	SCL=1;
	SCL=0;
}
/**********************************************
// IIC Write Command
**********************************************/
void Write_IIC_Command(u8 IIC_Command)
{
	IIC_Start();
	Write_IIC_Byte(0x78);            //Slave address,SA0=0
	Write_IIC_Byte(0x00);			//write command
	Write_IIC_Byte(IIC_Command);
	IIC_Stop();
}
/**********************************************
// IIC Write Data
**********************************************/
void Write_IIC_Data(u8 IIC_Data)
{
	IIC_Start();
	Write_IIC_Byte(0x78);			//D/C#=0; R/W#=0
	Write_IIC_Byte(0x40);			//write data
	Write_IIC_Byte(IIC_Data);
	IIC_Stop();
}
/*************************************************************************************/
void OLED_WR_Byte(u8 dat,u8 cmd)
{
	if(cmd) Write_IIC_Data(dat);
	else   Write_IIC_Command(dat);
}
//坐标设置
void OLED_Set_Pos(u8 x, u8 y)
{
	OLED_WR_Byte(0xb0+y,OLED_CMD);
	OLED_WR_Byte(((x&0xf0)>>4)|0x10,OLED_CMD);
	OLED_WR_Byte((x&0x0f),OLED_CMD);
}
//开启OLED显示
//void OLED_Display_On()
//{
//	OLED_WR_Byte(0X8D,OLED_CMD);  //SET DCDC命令
//	OLED_WR_Byte(0X14,OLED_CMD);  //DCDC ON
//	OLED_WR_Byte(0XAF,OLED_CMD);  //DISPLAY ON
//}
////关闭OLED显示
//void OLED_Display_Off()
//{
//	OLED_WR_Byte(0X8D,OLED_CMD);  //SET DCDC命令
//	OLED_WR_Byte(0X10,OLED_CMD);  //DCDC OFF
//	OLED_WR_Byte(0XAE,OLED_CMD);  //DISPLAY OFF
//}
//清屏函数,清完屏,整个屏幕是黑色的!和没点亮一样!!!
void OLED_Clear()
{
	u8 i,n;
	for(i=0; i<8; i++)
	{
		OLED_WR_Byte (0xb0+i,OLED_CMD);    //设置页地址（0~7）
		OLED_WR_Byte (0x00,OLED_CMD);      //设置显示位置—列低地址
		OLED_WR_Byte (0x10,OLED_CMD);      //设置显示位置—列高地址
		for(n=0; n<128; n++)OLED_WR_Byte(0,OLED_DATA);
	} //更新显示
}
//void OLED_On()
//{
//	u8 i,n;
//	for(i=0; i<8; i++)
//	{
//		OLED_WR_Byte (0xb0+i,OLED_CMD);    //设置页地址（0~7）
//		OLED_WR_Byte (0x00,OLED_CMD);      //设置显示位置—列低地址
//		OLED_WR_Byte (0x10,OLED_CMD);      //设置显示位置—列高地址
//		for(n=0; n<128; n++)OLED_WR_Byte(1,OLED_DATA);
//	} //更新显示
//}
//在指定位置显示一个字符,包括部分字符
//x:0~127
//y:0~3(12) 0~7(16)
//mode:0,反白显示;1,正常显示
//size:选择字体 16/8
void OLED_ShowChar(u8 x,u8 y,u8 chr,u8 Char_Size)
{
	unsigned char c=0,i=0;
	if(Char_Size==16) y*=2;
	c=chr-' ';//得到偏移后的值
	if(x>Max_Column-1)
	{
		x=0;
		y=y+2;
	}
	if(Char_Size ==16)
	{
		OLED_Set_Pos(x,y);
		for(i=0; i<8; i++)
			OLED_WR_Byte(F8X16[c*16+i],OLED_DATA);
		OLED_Set_Pos(x,y+1);
		for(i=0; i<8; i++)
			OLED_WR_Byte(F8X16[c*16+i+8],OLED_DATA);
	}
	else
	{
		OLED_Set_Pos(x,y);
		for(i=0; i<6; i++)
			OLED_WR_Byte(F6x8[c][i],OLED_DATA);
	}
}
//m^n函数
u32 oled_pow(u8 m,u8 n)
{
	u32 result=1;
	while(n--)result*=m;
	return result;
}
//显示2个数字
//x,y :起点坐标
//len :数字的位数
//size:字体大小
//mode:模式	0,填充模式;1,叠加模式
//num:数值(0~4294967295);
void OLED_ShowNum(u8 x,u8 y,u32 num,u8 len,u8 size2)
{
	u8 t,temp;
	u8 enshow=0;
	for(t=0; t<len; t++)
	{
		temp=(num/oled_pow(10,len-t-1))%10;
		if(enshow==0&&t<(len-1))
		{
			if(temp==0)
			{
				OLED_ShowChar(x+(size2/2)*t,y,' ',size2);
				continue;
			}
			else enshow=1;
		}
		OLED_ShowChar(x+(size2/2)*t,y,temp+'0',size2);
	}
}
/*显示一个字符号串
x:该行第几个像素 0~127
y:第几行  0~3
chr:       字符串
Char_Size: 字体大小 8/16
*/
void OLED_ShowString(u8 x,u8 y,u8 *chr,u8 Char_Size)
{
	u8 j=0;
	while (chr[j]!='\0')
	{
		OLED_ShowChar(x,y,chr[j],Char_Size);
		x+=8;
		if(x>120)
		{
			x=0;
			y+=2;
		}
		j++;
	}
}
/********************************************************************************/
/********************************************
// fill_Picture
********************************************/
void fill_picture(u8 fill_Data)
{
	u8 m,n;
	for(m=0; m<8; m++)
	{
		Write_IIC_Command(0xb0+m);		//page0-page1
		Write_IIC_Command(0x00);		//low column start address
		Write_IIC_Command(0x10);		//high column start address
		for(n=0; n<128; n++) //132
		{
			Write_IIC_Data(fill_Data);
		}
	}
}
/******************************************
// picture用来显示一个图片
*****************************************/
void Picture(u8 *addr)
{
	unsigned char x,y;
	unsigned int i=0;
	for(y=0; y<8; y++)
	{
		Write_IIC_Command(0xb0+y);
		Write_IIC_Command(0x0);
		Write_IIC_Command(0x10);
		for(x=0; x<128; x++)
		{
			Write_IIC_Data(addr[i++]);
		}
	}
}
/*
void Initlcd()  //Initial_M096128x64_ssd1306
{
	Write_IIC_Command(0xAE);   //display off
	Write_IIC_Command(0x20);	//Set Memory Addressing Mode
	Write_IIC_Command(0x10);	//00,Horizontal Addressing Mode;01,Vertical Addressing Mode;10,Page Addressing Mode (RESET);11,Invalid
	Write_IIC_Command(0xb0);	//Set Page Start Address for Page Addressing Mode,0-7
	Write_IIC_Command(0xc8);	//Set COM Output Scan Direction
	Write_IIC_Command(0x00);//---set low column address
	Write_IIC_Command(0x10);//---set high column address
	Write_IIC_Command(0x40);//--set start line address
	Write_IIC_Command(0x81);//--set contrast control register
	Write_IIC_Command(0xdf);
	Write_IIC_Command(0xa1);//--set segment re-map 0 to 127
	Write_IIC_Command(0xa6);//--set normal display
	Write_IIC_Command(0xa8);//--set multiplex ratio(1 to 64)
	Write_IIC_Command(0x3F);//
	Write_IIC_Command(0xa4);//0xa4,Output follows RAM content;0xa5,Output ignores RAM content
	Write_IIC_Command(0xd3);//-set display offset
	Write_IIC_Command(0x00);//-not offset
	Write_IIC_Command(0xd5);//--set display clock divide ratio/oscillator frequency
	Write_IIC_Command(0xf0);//--set divide ratio
	Write_IIC_Command(0xd9);//--set pre-charge period
	Write_IIC_Command(0x22); //
	Write_IIC_Command(0xda);//--set com pins hardware configuration
	Write_IIC_Command(0x12);
	Write_IIC_Command(0xdb);//--set vcomh
	Write_IIC_Command(0x20);//0x20,0.77xVcc
	Write_IIC_Command(0x8d);//--set DC-DC enable
	Write_IIC_Command(0x14);//
	Write_IIC_Command(0xaf);//--turn on oled panel
}
*/
void Initlcd()  //Initial_M096128x64_ssd1306
{
	u8 i;
	u8 code cmd[]=
	{
		0xAE, 0x20, 0x10, 0xb0,
		0xc8, 0x00, 0x10, 0x40,
		0x81, 0xdf, 0xa1, 0xa6,
		0xa8, 0x3F, 0xa4, 0xd3,
		0x00, 0xd5, 0xf0, 0xd9,
		0x22, 0xda, 0x12, 0xdb,
		0x20, 0x8d, 0x14, 0xaf
	};
	for(i=0; i<28; i++)
		Write_IIC_Command(cmd[i]);
}
#endif